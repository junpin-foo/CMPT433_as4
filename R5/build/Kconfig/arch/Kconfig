## R5/build/Kconfig/arch/Kconfig
```kconfig
# Load Zephyr Arch Kconfig descriptions.
osource "/home/junpinfoo/zephyrproject/zephyr/arch/x86/Kconfig"
osource "/home/junpinfoo/zephyrproject/zephyr/arch/xtensa/Kconfig"
osource "/home/junpinfoo/zephyrproject/zephyr/arch/sparc/Kconfig"
osource "/home/junpinfoo/zephyrproject/zephyr/arch/riscv/Kconfig"
osource "/home/junpinfoo/zephyrproject/zephyr/arch/posix/Kconfig"
osource "/home/junpinfoo/zephyrproject/zephyr/arch/nios2/Kconfig"
osource "/home/junpinfoo/zephyrproject/zephyr/arch/mips/Kconfig"
osource "/home/junpinfoo/zephyrproject/zephyr/arch/arm64/Kconfig"
osource "/home/junpinfoo/zephyrproject/zephyr/arch/arm/Kconfig"
osource "/home/junpinfoo/zephyrproject/zephyr/arch/arc/Kconfig"
```

## R5/build/Kconfig/boards/Kconfig.defconfig
```kconfig
# Load Zephyr board defconfig descriptions.
osource "/home/junpinfoo/zephyrproject/zephyr/boards/beagle/beagley_ai/Kconfig.defconfig"
```

## build/Kconfig/boards/Kconfig
```kconfig
# Load Zephyr board Kconfig descriptions.
osource "/home/junpinfoo/zephyrproject/zephyr/boards/beagle/beagley_ai/Kconfig"
```

## build/Kconfig/boards/Kconfig.beagley_ai
```kconfig
# Load board Kconfig descriptions.
osource "/home/junpinfoo/zephyrproject/zephyr/boards/beagle/beagley_ai/Kconfig.beagley_ai"
```

## build/Kconfig/boards/Kconfig.sysbuild
```kconfig
# Load Sysbuild board Kconfig descriptions.
osource "/home/junpinfoo/zephyrproject/zephyr/boards/beagle/beagley_ai/Kconfig.sysbuild"
```
